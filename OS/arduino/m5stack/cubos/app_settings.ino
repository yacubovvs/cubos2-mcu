#define appNameClass    SettingsApp          // App name without spaces
#define appName         "Settings"              // App name with spaces 

class appNameClass: public Application{
    public:
        virtual void onLoop() override;
        virtual void onDestroy() override;
        virtual void onEvent(byte event, int val1, int val2) override;
        void onCreate();
        appNameClass(){ fillScreen(64, 64, 64); super_onCreate(); onCreate(); };
        static unsigned const char* getParams(const unsigned char type){
            switch(type){ 
              case PARAM_TYPE_NAME: return (unsigned char*)appName; 
              case PARAM_TYPE_ICON: return icon;
              default: return (unsigned char*)""; }
        };
        const static byte icon[] PROGMEM;

        const static byte icon_sound[]      PROGMEM;
        const static byte icon_light[]      PROGMEM;
        const static byte icon_time[]       PROGMEM;
        const static byte icon_date[]       PROGMEM;
        const static byte icon_battery[]    PROGMEM;
      
};

void appNameClass::onCreate(){ 
    
    //Serial.println("On app created");
    
    drawMenuElement(true, 35, STYLE_STATUSBAR_HEIGHT + 15, SCREEN_WIDTH-10, 45, this->icon_sound, "String 1", "String 2");

    /*
        Write you code onCreate here
    */
}

void appNameClass::onLoop(){
    /*
        Write you code onLoop here
    */
}

void appNameClass::onDestroy(){
    /*
        Write you code onDestroy here
    */
}

void appNameClass::onEvent(byte event, int val1, int val2){
    
    if(event==EVENT_BUTTON_PRESSED){
        // Write you code on [val1] button pressed here
    }else if(event==EVENT_BUTTON_RELEASED){
        // Write you code on [val1] button released here
    }else if(event==EVENT_BUTTON_LONG_PRESS){
        // Write you code on [val1] button long press here
    }else if(event==EVENT_TIME_CHANGED){
        // Write you code on system time changed
    }
    
}

const byte appNameClass::icon_sound[] PROGMEM = {
    0x02,0x01,0x02,0x10,0x02,0x10,0x04,0xff,0xff,0xff,0x01,0x01,0x03,0x01,0x07,0x05,
    0x0F,0x05,0x1F,0x15,0xBF,0x15,0xBF,0x55,0xBF,0x55,0xBF,0x55,0xBF,0x55,0xBF,0x15,
    0x1F,0x15,0x0F,0x05,0x07,0x05,0x03,0x01,0x01,0x01,
};

const byte appNameClass::icon[] PROGMEM = {
    
	/*            PUT YOUR ICON HERE            */

    0x02,0x01,0x02,0x20,0x02,0x20,0x04,0xff,0xff,0xff,0x00,0x00,0x00,0x00,0x00,0x00,
    0x00,0x00,0x00,0x00,0x00,0x00,0x00,0x00,0x00,0x00,0x00,0x00,0x00,0x00,0x00,0x00,
    0x00,0x00,0x00,0x00,0x00,0x00,0x00,0x00,0x00,0x00,0x00,0x00,0x00,0x00,0x00,0x00,
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    0x00,0x00,
};