#define appNameClass    I2CScannerApp          // App name without spaces
#define appName         "I2C scanner"              // App name with spaces 

class appNameClass: public Application{
    public:
        virtual void onLoop() override;
        virtual void onDestroy() override;
        virtual void onEvent(byte event, int val1, int val2) override;

        void onCreate();
        appNameClass(){ fillScreen(0, 0, 0); super_onCreate(); onCreate(); };
        static unsigned const char* getParams(const unsigned char type){
            switch(type){ 
              case PARAM_TYPE_NAME: return (unsigned char*)appName; 
              case PARAM_TYPE_ICON: return icon;
              default: return (unsigned char*)""; }
        };
        const static byte icon[] PROGMEM;
      
};

#include <Wire.h>

void appNameClass::onCreate(){
    /*
        Write you code onCreate here
    */
    setDrawColor(255, 255, 255);
    

    Wire.begin();
    byte error, address;
    int nDevices;
 
    debug("Scanning...", 1000);
 
    nDevices = 0;
    for(address = 8; address < 127; address++ ){
        //if(address==104) continue;
        Wire.beginTransmission(address);
        error = Wire.endTransmission();
 
        #ifdef ESP8266
            ESP.wdtDisable();
        #endif

        if (error == 0){
            debug("I2C device found at address 0x", 1000);
            if (address<16)
                debug("0", 1000);
            //Serial.print(address,HEX);
            debug(String(address), 1000);
            //debug("!", 1000);
 
            nDevices++;
        }
        else if (error==4) {
            debug("Unknow error at address 0x", 1000);
            if (address<16)
                debug("0", 1000);
            //Serial.println(address,HEX);
            debug(String(address));
        } 
    }
    if (nDevices == 0)
        debug("No I2C devices found", 1000);
    else
        debug("done", 1000);
 
}

void appNameClass::onLoop(){
    /*
        Write you code onLoop here
    */
}

void appNameClass::onDestroy(){
    /*
        Write you code onDestroy here
    */
}

void appNameClass::onEvent(byte event, int val1, int val2){
    
    if(event==EVENT_BUTTON_PRESSED){
        // Write you code on [val1] button pressed here
        if(val1==BUTTON_BACK){
            startApp(-1);
        }
    }else if(event==EVENT_BUTTON_RELEASED){
        // Write you code on [val1] button released here
    }else if(event==EVENT_BUTTON_LONG_PRESS){
        // Write you code on [val1] button long press here
    }else if(event==EVENT_TIME_CHANGED){
        // Write you code on system time changed
    }
    
}

const byte appNameClass::icon[] PROGMEM = {
    
	/*            PUT YOUR ICON HERE            */

    0x02,0x01,0x02,0x20,0x02,0x20,0x04,0xff,0xd9,0x00,0x00,0x30,0x00,0x00,0x00,0x48,0x00,0x00,0x3C,0x08,0x1F,
    0xE0,0x3C,0x10,0x3F,0xF8,0x3C,0x20,0x78,0x3C,0x3C,0x78,0xF0,0x1C,0x3C,0x00,0xE0,0x1C,0x3C,0x00,0xE0,0x00,
    0x3C,0x00,0xE0,0x00,0x3C,0x00,0xE0,0x00,0x3C,0x00,0xE0,0x00,0x3C,0x00,0xE0,0x00,0x3C,0x00,0xE0,0x00,0x3C,
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    0x80,0x20,0x10,

};